/dts-v1/;
/plugin/;

/ {
    compatible = "brcm,bcm2835";

    fragment@0 {
        target = <&i2c1>;
        __overlay__ {
            #address-cells = <1>;
            #size-cells = <0>;
            status = "okay";

            mpu6050_sensor: mpu6050@68 {
                compatible = "roadpainter,mpu6050";
                reg = <0x68>;
                status = "okay";
            };
        };
    };
};
